#include "butterfree.dtsi" // The shared dtsi file is included in the overlay

// Label of the kscan node in the dtsi
&kscan0 {
    col-gpios
        = <&pro_micro 21 GPIO_ACTIVE_HIGH>
        , <&pro_micro 20 GPIO_ACTIVE_HIGH>
        , <&pro_micro 19 GPIO_ACTIVE_HIGH>
        , <&pro_micro 18 GPIO_ACTIVE_HIGH>
        , <&pro_micro 15 GPIO_ACTIVE_HIGH>
        , <&pro_micro 14 GPIO_ACTIVE_HIGH>
        , <&pro_micro 16 GPIO_ACTIVE_HIGH>
        , <&pro_micro 10 GPIO_ACTIVE_HIGH>
        ;
};

&left_encoder: encoder_left {
    compatible = "alps,ec11";5
    a-gpios = <2   (GPIO_ACTIVE_HIGH | GPIO_PULL_UP)>;
    b-gpios = <3 (GPIO_ACTIVE_HIGH | GPIO_PULL_UP)>;
    steps = <80>;
    status = "disabled";
};

sensors: sensors {
    compatible = "zmk,keymap-sensors";
    sensors = <&left_encoder>;
    triggers-per-rotation = <20>;
};

&left_encoder {
    status = "okay";
};