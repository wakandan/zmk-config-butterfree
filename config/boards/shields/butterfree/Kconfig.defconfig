## config/boards/shields/butterfree/Kconfig.defconfig
```kconfig
if SHIELD_BUTTERFREE_LEFT

# Name must be less than 16 characters long!
config ZMK_KEYBOARD_NAME
    default "Butterfree"

config ZMK_SPLIT_ROLE_CENTRAL
    default y

endif

if SHIELD_BUTTERFREE_LEFT || SHIELD_BUTTERFREE_RIGHT

config ZMK_SPLIT
    default y

endif
```

## config/boards/shields/butterfree/Kconfig.shield
```kconfig
# No whitespace after the comma or in your part name!
config SHIELD_BUTTERFREE_LEFT
    def_bool $(shields_list_contains,butterfree_left)

# No whitespace after the comma or in your part name!
config SHIELD_BUTTERFREE_RIGHT
    def_bool $(shields_list_contains,butterfree_right)
```
