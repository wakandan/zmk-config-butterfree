#include "butterfree.dtsi" // The shared dtsi file is included in the overlay

// Label of the kscan node in the dtsi
&kscan0 {
    col-gpios
        = <&pro_micro 21 GPIO_ACTIVE_HIGH> // 21
        , <&pro_micro 20 GPIO_ACTIVE_HIGH> // 20
        , <&pro_micro 19 GPIO_ACTIVE_HIGH> //19
        , <&pro_micro 18 GPIO_ACTIVE_HIGH> //18
        , <&pro_micro 15 GPIO_ACTIVE_HIGH> //15
        , <&pro_micro 14 GPIO_ACTIVE_HIGH> //14
        , <&pro_micro 16 GPIO_ACTIVE_HIGH> //16
        , <&pro_micro 10 GPIO_ACTIVE_HIGH> //10
        ;
};

&default_transform { // Offset of 8 because the left side has 8 columns
    col-offset = <8>;
};